## ControlModule/BleFirmware/boards/timetaker/tt_ble/Kconfig.defconfig
```kconfig
# TimeTaker BLE bridge board defaults.

if BOARD_TT_BLE

config HW_STACK_PROTECTION
	default ARCH_HAS_STACK_PROTECTION

endif # BOARD_TT_BLE
```

## ControlModule/BleFirmware/boards/timetaker/tt_ble/board.yml
```yaml
board:
  name: tt_ble
  full_name: TimeTaker BLE bridge (Raytac MDBT42T-P, nRF52805)
  vendor: timetaker
  socs:
  - name: nrf52805
```
